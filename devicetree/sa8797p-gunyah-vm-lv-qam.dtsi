// SPDX-License-Identifier: BSD-3-Clause
/*
 * Copyright (c) Qualcomm Technologies, Inc. and/or its subsidiaries.
 */

#include "sa8797p-gunyah-vm-lv.dtsi"

&vm_config {
	/* Pass through regions */
	iomemory-ranges = <
		/* GPU region */
		0x0 0x3D41000 0x0 0x3D41000 0x0 0x1000 0x0
		0x0 0x9841000 0x0 0x9841000 0x0 0x1000 0x0
		/* MPROC NS2 IPCC region */
		0x0 0x9009000 0x0 0x9009000 0x0 0x1000 0x0
		/* MDSS 0 region */
		0x0 0xAE00000 0x0 0xAE00000 0x0 0x180000 0x1
		/* MDSS 0 LUT DMA CTL region */
		0x0 0x0AF80000 0x0 0x0AF80000 0x0 0x1000 0x1
		/* MDSS 0 LUT DMA VQ region */
		0x0 0x0AF81000 0x0 0x0AF81000 0x0 0x10000 0x0
		/* MDSS 0 VA_TRAN CTL region */
		0x0 0xAFA4000 0x0 0xAFA4000 0x0 0x1000 0x1
		/* MDSS 0 VA_TRAN VQ region */
		0x0 0xAFA5000 0x0 0xAFA5000 0x0 0x10000 0x0
		/* MDSS 1 region */
		0x0 0x8C00000 0x0 0x8C00000 0x0 0x180000 0x1
		/* MDSS 1 LUT DMA CTL region */
		0x0 0x8D80000 0x0 0x8D80000 0x0 0x1000 0x1
		/* MDSS 1 LUT DMA VQ region */
		0x0 0x8D81000 0x0 0x8D81000 0x0 0x10000 0x0
		/* MDSS 1 VA_TRAN CTL region */
		0x0 0x8DA4000 0x0 0x8DA4000 0x0 0x1000 0x1
		/* MDSS 1 VA_TRAN VQ region */
		0x0 0x8DA5000 0x0 0x8DA5000 0x0 0x10000 0x0
	>;

	/* Pass through IRQs */
	gic-irq-ranges = <
		/* GPU GIC IRQ */
		677 677
		894 894
		/* MPROC NS2 IPCC GIC IRQ */
		990 990
	>;
};

